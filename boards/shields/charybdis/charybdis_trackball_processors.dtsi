#include "charybdis_layers.h"
#include <input/processors.dtsi>
#include <dt-bindings/zmk/input_transform.h>
#include <zephyr/dt-bindings/input/input-event-codes.h>

/* Applied at the central: locally on the right half or on the XIAO dongle. */
#define CHARYBDIS_TRACKBALL_PROCESSORS \
    input-processors = <&zip_xy_scaler 5 5>; \
    scroller: scroller { \
        layers = <RAISE>; \
        input-processors = <&zip_xy_scaler 1 15 &zip_xy_to_scroll_mapper \
                            &zip_scroll_transform (INPUT_TRANSFORM_Y_INVERT)>; \
    }; \
    slow_pointer: slow_pointer { \
        layers = <NAV>; \
        input-processors = <&zip_xy_scaler 1 5>; \
    };
